## package/hello-world-kmod/Config.in
```kconfig
config BR2_PACKAGE_HELLO-WORLD-KMOD
	bool "hello-world-kmod"
	depends on BR2_LINUX_KERNEL
	help
	  This is a kernel modul
```

## package/mykmod/Config.in
```kconfig
config BR2_PACKAGE_MYKMOD
	bool "mykmod"
	depends on BR2_LINUX_KERNEL
	help
	  This is a kernel module
```
